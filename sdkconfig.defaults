## sdkconfig.defaults
```kconfig
# sdkconfig.defaults
# Configuration file for ESP-IDF

# Logging
CONFIG_LOG_DEFAULT_LEVEL=3  # INFO level
CONFIG_LOG_MAXIMUM_LEVEL=5  # VERBOSE level

# Memory
CONFIG_SPIRAM_SUPPORT=y
CONFIG_SPIRAM_SIZE=4194304
CONFIG_SPIRAM_MODE_QUAD=y
CONFIG_HEAP_MEMORY_ALLOC_MAX=80000

# FreeRTOS
CONFIG_FREERTOS_TICK_RATE_HZ=1000
CONFIG_FREERTOS_MAX_TASK_NAME_LEN=16
CONFIG_FREERTOS_IDLE_TASK_STACKSIZE=2048

# WiFi
CONFIG_ESP32_WIFI_RX_BA_WIN_SIZE=6
CONFIG_ESP32_WIFI_TX_BA_WIN_SIZE=6

# MQTT
CONFIG_MQTT_USE_CUSTOM_CONFIG=y

# Custom app config
CONFIG_DHT_PIN=4
CONFIG_RELAY_PIN=5
CONFIG_FAN_PIN=18
```
